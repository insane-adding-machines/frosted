## kernel/lpc17xx/Kconfig
```kconfig
if ARCH_LPC17XX

choice 
    prompt "MCU"
    default ARCH_LPC1768
config ARCH_LPC1763
    bool "LPC1763"
    select FLASH_SIZE_256KB
    select RAM_SIZE_32KB
config ARCH_LPC1764
    bool "LPC1764"
    select FLASH_SIZE_128KB
    select RAM_SIZE_16KB
config ARCH_LPC1765
    bool "LPC1765"
    select FLASH_SIZE_256KB
    select RAM_SIZE_32KB
config ARCH_LPC1766
    bool "LPC1766"
    select FLASH_SIZE_256KB
    select RAM_SIZE_32KB
config ARCH_LPC1767
    bool "LPC1767"
    select FLASH_SIZE_512KB
    select RAM_SIZE_32KB
config ARCH_LPC1768
    bool "LPC1768"
    select FLASH_SIZE_512KB
    select RAM_SIZE_32KB
config ARCH_LPC1769
    bool "LPC1769"
    select FLASH_SIZE_512KB
    select RAM_SIZE_32KB
endchoice

endif
```

## kernel/lpc43xx/Kconfig
```kconfig
if ARCH_LPC43XX

choice
    prompt "MCU"
    default ARCH_LPC4330
config ARCH_LPC4330
    bool "LPC4330"
    select FLASH_SIZE_1MB
    select RAM_SIZE_128KB
    select CLK_100MHZ
endchoice

endif
```

## kernel/net/Kconfig
```kconfig
if PICOTCP 

menu "picoTCP configuration"

config CONFIG_PICOTCP_IPV4
    bool "Support for IP version 4"
    default y

config CONFIG_PICOTCP_IPV6
    bool "Support for IP version 6"
    default n

config CONFIG_PICOTCP_TCP
    bool "Support for TCP"
    default y

config CONFIG_PICOTCP_UDP
    bool "Support for UDP"
    default y

config CONFIG_PICOTCP_DNS
    bool "Support for DNS client"
    default y

config CONFIG_PICOTCP_MCAST
    bool "Support for Multicast"
    default n

config CONFIG_PICOTCP_NAT
    bool "Support for NAT"
    default n

config CONFIG_PICOTCP_IPFILTER
    bool "Support for IP Filter"
    default n

config CONFIG_PICOTCP_LOOP
    bool "Support for loopback device"
    default y

config CONFIG_PICOTCP_DEBUG
    bool "Activate debugging symbols"
    default n

endmenu
endif
```

## kernel/nrf51/Kconfig
```kconfig
if ARCH_NRF51

choice
    prompt "MCU"
    default ARCH_NRF51822_QFAC

config ARCH_NRF51822_QFAA
    bool "NRF51822_QFAA 256KB/16KB"
    select FLASH_SIZE_256KB
    select RAM_SIZE_16KB
    select ARCH_NRF51822
config ARCH_NRF51822_QFAB
    bool "NRF51822_QFAB 128KB/16KB"
    select FLASH_SIZE_128KB
    select RAM_SIZE_16KB
    select ARCH_NRF51822
config ARCH_NRF51822_CEAA
    bool "NRF51822_CEAA 256KB/16KB"
    select FLASH_SIZE_256KB
    select RAM_SIZE_16KB
    select ARCH_NRF51822
config ARCH_NRF51822_QFAC
    bool "NRF51822_QFAC 256KB/32KB"
    select FLASH_SIZE_256KB
    select RAM_SIZE_32KB
    select ARCH_NRF51822
config ARCH_NRF51822_CDAB
    bool "NRF51822_CDAB 128KB/16KB"
    select FLASH_SIZE_128KB
    select RAM_SIZE_16KB
    select ARCH_NRF51822
config ARCH_NRF51822_CEAA
    bool "NRF51822_CEAA 256KB/16KB"
    select FLASH_SIZE_256KB
    select RAM_SIZE_16KB
    select ARCH_NRF51822
config ARCH_NRF51822_CFAC
    bool "NRF51822_CFAC 256KB/32KB"
    select FLASH_SIZE_256KB
    select RAM_SIZE_32KB
    select ARCH_NRF51822
config ARCH_NRF51822_CTAC
    bool "NRF51822_CTAC 256KB/32KB"
    select FLASH_SIZE_256KB
    select RAM_SIZE_32KB
    select ARCH_NRF51822
config ARCH_NRF51822_CTAA
    bool "NRF51822_CTAA 256KB/16KB"
    select FLASH_SIZE_256KB
    select RAM_SIZE_16KB
    select ARCH_NRF51822
config ARCH_NRF51822_WFAC
    bool "NRF51822_WFAC 256KB/32KB"
    select FLASH_SIZE_256KB
    select RAM_SIZE_32KB
    select ARCH_NRF51822
endchoice

endif
```

## kernel/nrf52/Kconfig
```kconfig
if ARCH_NRF52

choice
    prompt "MCU"
    default ARCH_NRF52832

config ARCH_NRF52840
    bool "NRF52840 1MB/512KB"
    select FLASH_SIZE_1MB
    select RAM_SIZE_512KB
config ARCH_NRF52832
    bool "NRF52832 512KB/64KB"
    select FLASH_SIZE_512KB
    select RAM_SIZE_64KB
config ARCH_NRF52810
    bool "NRF52810 192KB/24KB"
    select FLASH_SIZE_192KB
    select RAM_SIZE_24KB
endchoice

endif
```

## kernel/rtl8710/Kconfig
```kconfig
if ARCH_RTL8710

choice 
    prompt "MCU"
    default RTL8710AF
config ARCH_RTL8710AF
    bool "RTL8710AF System on chip (Pine64 IoT PADI)"
    select FLASH_SIZE_1M
    select RAM_SIZE_448KB
endchoice
endif
```

## kernel/stm32f4/Kconfig
```kconfig
if ARCH_STM32F4

choice 
    prompt "MCU"
    default ARCH_STM32F407_XG

config ARCH_STM32F401_XB
    bool "STM32F401xB 128KB"
    select FLASH_SIZE_128KB
    select RAM_SIZE_64KB
    select ARCH_STM32F401
config ARCH_STM32F401_XC
    bool "STM32F401xC 256KB"
    select FLASH_SIZE_256KB
    select RAM_SIZE_64KB
    select ARCH_STM32F401
config ARCH_STM32F401_XD
    bool "STM32F401xD 384KB"
    select FLASH_SIZE_384KB
    select RAM_SIZE_96KB
    select ARCH_STM32F401
config ARCH_STM32F401_XE
    bool "STM32F401xE 512KB"
    select FLASH_SIZE_512KB
    select RAM_SIZE_96KB
    select ARCH_STM32F401

config ARCH_STM32F405_XG
    bool "STM32F405xG 1MB"
    select FLASH_SIZE_1MB
    select RAM_SIZE_192KB
    select ARCH_STM32F405
config ARCH_STM32F405_XE
    bool "STM32F407xE 512KB"
    select FLASH_SIZE_512KB
    select RAM_SIZE_192KB
    select ARCH_STM32F405

config ARCH_STM32F407_XG
    bool "STM32F407xG 1MB"
    select FLASH_SIZE_1MB
    select RAM_SIZE_192KB
    select ARCH_STM32F407
config ARCH_STM32F407_XE
    bool "STM32F407xE 512KB"
    select FLASH_SIZE_512KB
    select RAM_SIZE_192KB
    select ARCH_STM32F407
    
config ARCH_STM32F411_XE
    bool "STM32F411xE 512KB"
    select FLASH_SIZE_512KB
    select RAM_SIZE_128KB
    select ARCH_STM32F411
config ARCH_STM32F411_XC
    bool "STM32F411xC 256KB"
    select FLASH_SIZE_256KB
    select RAM_SIZE_128KB
    select ARCH_STM32F411

config ARCH_STM32F429_XE
    bool "STM32F429xE 512KB"
    select FLASH_SIZE_512KB
    select RAM_SIZE_256KB
    select ARCH_STM32F429
config ARCH_STM32F429_XG
    bool "STM32F429xG 1MB"
    select FLASH_SIZE_1MB
    select RAM_SIZE_256KB
    select ARCH_STM32F429
config ARCH_STM32F429_XI
    bool "STM32F429xI 2MB"
    select FLASH_SIZE_2MB
    select RAM_SIZE_256KB
    select ARCH_STM32F429
config ARCH_STM32F446_ZE
    bool "STM32F446ZE 512KB"
    select FLASH_SIZE_512KB
    select RAM_SIZE_128KB
    select ARCH_STM32F446
endchoice

endif
```

## kernel/stm32f7/Kconfig
```kconfig
if ARCH_STM32F7

choice 
    prompt "MCU"
    default ARCH_STM32F746_NG

config ARCH_STM32F746_NG
    bool "STM32F746NG 1MB"
    select FLASH_SIZE_1MB
    select RAM_SIZE_320KB
    select ARCH_STM32F746

config ARCH_STM32F769_NI
    bool "STM32F769NI 2MB"
    select FLASH_SIZE_2MB
    select RAM_SIZE_368KB
    select ARCH_STM32F769

endchoice

endif
```
