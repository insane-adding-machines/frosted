## apps/Kconfig
```kconfig
menu "Applications"
        config FRESH
        bool "FreSH shell application"
        default y

        config SCSH
        bool "Simple C-Shell"
        default y

        config TASK2
        bool "Generic syscall test 'task2'"
        default y

        config PRODCONS
        bool "IPC testing (prod/cons)"
        default y
        

endmenu
```
